## main/Kconfig.projbuild
```kconfig
menu "NMEA gateway"

    # Defaults only: the "can" settings page overrides both at runtime, so a
    # board with other wiring needs no rebuild. -1 there means "use these".
    config NMEA_GW_CAN_TX_GPIO
        int "Default CAN TX GPIO"
        default 32 if IDF_TARGET_ESP32
        default 22 if IDF_TARGET_ESP32P4
        default 4
        help
            GPIO wired to the CAN transceiver's TXD when the tx_pin setting is
            -1. ESP32: the SH-ESP32 board. ESP32-P4: the CAN transceiver on the
            Waveshare Touch-LCD-7B (TX 22, RX 21, as the P4 cockpit uses it).
            The others: GPIO 4, free on the common dev kits of those chips.

    config NMEA_GW_CAN_RX_GPIO
        int "Default CAN RX GPIO"
        default 34 if IDF_TARGET_ESP32
        default 21 if IDF_TARGET_ESP32P4
        default 5
        help
            GPIO wired to the CAN transceiver's RXD when the rx_pin setting is
            -1. See the TX pin for where each default comes from.

endmenu
```
